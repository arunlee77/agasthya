## meta-agasthya/conf/layer.conf
```bitbake
# We have a conf and classes directory, add to BBPATH
BBPATH =. "${LAYERDIR}:"

# We have recipes-* directories, add to BBFILES
BBFILES += "${LAYERDIR}/recipes-*/*/*.bb \
            ${LAYERDIR}/recipes-*/*/*.bbappend"

BBFILE_COLLECTIONS += "agasthya"
BBFILE_PATTERN_agasthya = "^${LAYERDIR}/"
BBFILE_PRIORITY_agasthya = "5"

LAYERSERIES_COMPAT_agasthya = "kirkstone"

# This should only be incremented on significant changes that will
# cause compatibility issues with other layers
LAYERVERSION_agasthya = "3"

LAYERDEPENDS_agasthya = "core"

REQUIRED_POKY_BBLAYERS_CONF_VERSION = "2"
```

## yocto/meta-agasthya/conf/distro/agasthya.conf
```bitbake
DISTRO = "agasthya"
DISTRO_NAME = "Agansthya (A Yocto Based Distro)"
DISTRO_VERSION = "0.0.1"
DISTRO_CODENAME = "kirkstone"
SDK_VENDOR = "-agasthyasdk"
SDK_VERSION = "${@d.getVar('DISTRO_VERSION').replace('snapshot-${METADATA_REVISION}', 'snapshot')}"
SDK_VERSION[vardepvalue] = "${SDK_VERSION}"

MAINTAINER = "Arun Ravindran <arunlee@gmail.com>"

TARGET_VENDOR = "-agasthya"

LOCALCONF_VERSION = "2"

# Override these in poky based distros
AGASTHYA_DEFAULT_DISTRO_FEATURES = "largefile opengl ptest multiarch wayland vulkan"
AGASTHYA_DEFAULT_EXTRA_RDEPENDS = "packagegroup-core-boot"
AGASTHYA_DEFAULT_EXTRA_RRECOMMENDS = "kernel-module-af-packet"

DISTRO_FEATURES ?= "${DISTRO_FEATURES_DEFAULT} ${POKY_DEFAULT_DISTRO_FEATURES}"

PREFERRED_VERSION_linux-yocto ?= "5.15%"
PREFERRED_VERSION_linux-yocto-rt ?= "5.15%"

SDK_NAME = "${DISTRO}-${TCLIBC}-${SDKMACHINE}-${IMAGE_BASENAME}-${TUNE_PKGARCH}-${MACHINE}"
SDKPATHINSTALL = "/opt/${DISTRO}/${SDK_VERSION}"

DISTRO_EXTRA_RDEPENDS += "${AGASTHYA_DEFAULT_EXTRA_RDEPENDS}"
DISTRO_EXTRA_RRECOMMENDS += "${AGASTHYA_DEFAULT_EXTRA_RRECOMMENDS}"

TCLIBCAPPEND = ""

#require conf/distro/include/poky-world-exclude.inc
require conf/distro/include/no-static-libs.inc
require conf/distro/include/yocto-uninative.inc
require conf/distro/include/security_flags.inc
INHERIT += "uninative"

BB_SIGNATURE_HANDLER ?= "OEEquivHash"
BB_HASHSERVE ??= "auto"
```
